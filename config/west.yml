## config/west.yml
```yaml
manifest:
  remotes:
    - name: PaulDStevenson
      url-base: https://github.com/PaulDStevenson
  projects:
    - name: zmk-experimental
      remote: PaulDStevenson
      revision: local
      import: app/west.yml
  self:
    path: config
```
